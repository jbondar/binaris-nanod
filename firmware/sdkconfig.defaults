## firmware/sdkconfig.defaults
```kconfig
# NanoD ESP32-S3 configuration
CONFIG_IDF_TARGET="esp32s3"

# Flash: 4MB QIO 80MHz
CONFIG_ESPTOOLPY_FLASHSIZE_4MB=y
CONFIG_ESPTOOLPY_FLASHMODE_QIO=y
CONFIG_ESPTOOLPY_FLASHFREQ_80M=y

# PSRAM
CONFIG_ESP32S3_SPIRAM_SUPPORT=y
CONFIG_SPIRAM=y

# CPU: 240MHz
CONFIG_ESP_DEFAULT_CPU_FREQ_240=y

# Watchdog — don't watch IDLE tasks (FOC loop monopolizes Core 1)
CONFIG_ESP_TASK_WDT_TIMEOUT_S=10
CONFIG_ESP_TASK_WDT_CHECK_IDLE_TASK_CPU0=y
CONFIG_ESP_TASK_WDT_CHECK_IDLE_TASK_CPU1=n

# Main task stack size (default 3584 is too small for Rust std + channel setup)
CONFIG_ESP_MAIN_TASK_STACK_SIZE=8192

# Console on USB Serial/JTAG (built-in debug port, always available)
CONFIG_ESP_CONSOLE_USB_SERIAL_JTAG=y

# MCPWM (motor control PWM)
CONFIG_SOC_MCPWM_SUPPORTED=y

# Partition table — custom: 3MB app, 960KB SPIFFS, 24KB NVS
CONFIG_PARTITION_TABLE_CUSTOM=y
CONFIG_PARTITION_TABLE_CUSTOM_FILENAME="/Users/jake.bondar/repos/NanoD-Integrations/firmware/partitions.csv"
```
